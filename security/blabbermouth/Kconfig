## security/blabbermouth/Kconfig
```kconfig
config SECURITY_BLABBERMOUTH
	bool "BLABBERMOUTH Support"
	depends on SECURITY
	select NETWORK_SECMARK
	default n
	help
	  This selects BlabberMouth LSM.
          see recluze.wordpress.com for more details
```
